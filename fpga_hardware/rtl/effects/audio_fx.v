// =============================================================================
//  audio_fx.v —— 级联式硬件音频效果器（旁路 / 延迟 / 合唱 / 混响）
//
//  赛题【拓展②】要求「硬件混响/延迟/合唱」—— 本模块就是这一项的硬件实现。
//  全程纯 HDL、逐样本运算，不依赖 CPU/软核（赛题基础要求②）。
//
//  ===========================================================================
//  ★ 架构
//  ===========================================================================
//      fx_in ──┬───────────────────────────────────────────────► 旁路(00)
//              │
//              ├─► fx_echo     (延迟线 32768 + 反馈)      ──► 延迟(01)
//              ├─► fx_chorus   (2048 + LFO 调制延迟)      ──► 合唱(10)
//              └─► ┌─ fx_comb ×4 (2471/2631/2828/3003) ┐
//                  │       并联求和                    │
//                  └─► fx_allpass ×2 (1231/977, g=0.5) ─┴─► 混响(11)
//
//  三条效果支路**永远都在跑**（不按 fx_sel 门控），输出用一个 2:1…4:1 选择器
//  切换。理由：97 656.25 Hz 下一共有 512 个 clk 的预算，而每条支路只占 1 拍，
//  门控省下的动态功耗可以忽略；反而"切走再切回"会读到陈旧数据、尾巴断裂。
//  一直跑 ⇒ 切到混响时它的尾巴已经在衰减了，听感更自然（真效果器的 spillover）。
//
//  ===========================================================================
//  ★★ 上电必须清 BSRAM（否则反馈回路会锁死成满幅直流）★★
//  ===========================================================================
//  这不是理论担忧，是参考实现用一次构建换来的教训。xls32-fpga-synth 的
//  M13 里程碑原文（原文照抄）：
//      "An **uninitialized BRAM seeds a feedback loop** (echo railed):
//       **clear the buffer** (sweep-write 0) at reset."
//  机理：BSRAM 上电内容未定义（仿真是 X，硬件是随机位）。延迟线在**反馈回路里**，
//  读出来的垃圾被加上输入再写回去、来回放大，几十毫秒内就顶到饱和并**停在那里**
//  （rail），此后输出恒为满幅直流，听起来是"啪"的一声然后死掉。
//  ⇒ 本模块在复位释放后用 32768 拍把**所有**延迟线扫一遍写 0（≈336 µs @50 MHz），
//    期间输出强制静音。清缓冲优先于正常写（每个数组仍然只有一处写语句）。
//
//  ===========================================================================
//  ★ 定点化与"绝不发散"的设计（这是效果器最容易翻车的地方）
//  ===========================================================================
//  1. 所有反馈系数都严格 < 1.0（Q8 的 256）：混响梳状 0.625~0.871、全通 0.5、
//     延迟 0.375~0.621。
//  2. 所有写回延迟线/状态的值都过 sat16 饱和，**绝不回绕**。回绕会让正峰变负峰，
//     在反馈回路里等于把增益变成 |g| 的符号翻转 → 立刻发散。
//  3. 所有乘法**在全宽网络上形成后再移位**（本项目在包络/变调乘法上反复踩过
//     "先截断再移位 → 变噪声"的坑）。
//  4. 阻尼用**凸组合**（两系数和恰为 256）⇒ 中间量数学上不可能越界（见 fx_comb.v）。
//  5. 混响输入取**固定小增益 1/32**，而不是"按 1/(1-g) 匹配"。
//     参考实现记录过这个反例（xls32 M14 原文）：
//        "**Matched input attenuation `1/(1−g)` was the wrong idea** — it makes
//         cathedral's input 32× smaller, so at non-resonant frequencies the tail is
//         inaudible. A *fixed* small input (Freeverb) is correct."
//     固定小输入的好处：房间越大（g 越大）尾巴**响得更久**，而不是变得更轻。
//
//  ===========================================================================
//  ★ 输入电平必须算过（参考实现记录过的反例）
//  ===========================================================================
//  梳状滤波器的**直流增益 = 1/(1-g)**。g 取到 0.9453 时是 18.3 倍。
//  所以送进反馈环的输入**绝不能是满幅信号**。定量约束（这一步很容易写错）：
//      稳态 b = x + g·b  ⇒  b = x/(1-g)
//      要内部状态 |b| ≤ 1（满幅），就必须  A_in ≤ 1 - g_max
//  ⚠️ 注意是 **1 - g_max**，不是 1/(1-g_max)（后者量纲不对、毫无约束力）。
//     dsh-plugins 先给错过一次这个公式，已勘误 —— 这里按勘误后的正确形式。
//     反过来自检：Freeverb 取 g_max = 0.98 ⇒ A_in ≤ 0.02，它实际用 0.015
//     （留 25% 余量）—— 公式与它的 fixedgain 互相印证。
//  ⇒ 本设计取 **A_in = 1/64 = 0.015625**：
//        g_max = 0.9453 ⇒ 允许上限 1 - 0.9453 = **0.0547**
//        0.015625 ≤ 0.0547 ✅ **余量 3.5 倍**，内部状态峰值
//        b_max = 0.015625 / 0.0547 = **0.286 满幅** ⇒ 反馈环内永不饱和
//        （这一点很重要：内部一旦饱和就成了非线性环节，尾巴会变形甚至自持）
//    而输出级是 `fx_in + wet`，它会饱和 —— 那是**输出限幅**，是正常且安全的，
//    与"反馈环内部饱和"是两回事。湿声最大约 0.28 满幅（param=127 时）。
//  ⚠️ 本设计是**单声道**（契约里 fx_in/fx_out 各一路），所以不涉及 Freeverb 的
//     `stereospread = 23`（右声道每路 +23 个 44.1 kHz 样本）以及它的正确缩放
//     `round((orig+23)×k)`。将来若要做立体声，请用 dsh-plugins 交付的
//     `tools/gen/scale_freeverb.py` 输出（它已自检：--fs 44100 时 COMB L1 = 1116）。
//
//  ===========================================================================
//  ★ 关于"算术右移对负数向 −∞ 取整"会不会把 g 推过 1
//  ===========================================================================
//  dsh-plugins 提醒：定点乘法后算术右移对负数是向 −∞ 取整，幅值反而略大 ⇒
//  等效 g_eff > g，当 g 贴近 1 时（如 0.98）可能把环路推过 1，表现为"几十秒后
//  缓慢自激"。对策是移位前加半个 LSB 做四舍五入，并给 g 留 1~2% 余量。
//  本设计**不需要加四舍五入**，理由（可核算）：
//    · 每拍引入的偏差是**有界的加性扰动**（≤1 LSB），不是乘性增益放大；
//      环路增益 0.9453 时，这个扰动累积上限 = 1/(1-0.9453) ≈ 18.3 LSB
//      = 满幅的 0.056%。既不可能让环路自激，也听不出来。
//    · 真正的危险是 g_eff ≥ 1；本设计 g 最大 0.9453，余量 5.5%，远大于 1 LSB
//      所能造成的相对误差（对大信号而言远小于 0.01%）。
//  ⚠️ 这是"分析"，不是"实测"。**由 tb_effects.v 长跑实测兜底**：混响跑满 1 秒
//     采样并在最后检查尾巴是否单调衰减到接近 0、且全程无增长趋势。
//
//  ===========================================================================
//  ★ 延迟长度全部按【实际采样率 97 656.25 Hz】折算（Lead 明确提醒过这个坑）
//  ===========================================================================
//  混响的梳状/全通延迟取自 Freeverb 的经典调音（44.1 kHz 下的
//  1116/1188/1277/1356 与 556/441），**按 97 656.25/44 100 = 2.2144 倍缩放**：
//      1116 → 2471    1188 → 2631    1277 → 2828    1356 → 3003
//      556  → 1231    441  → 977
//  照抄 48 kHz 的数值会让所有延迟偏短 2 倍以上，混响听起来会"紧"得不像混响。
//  （同样的换算也出现在参考实现里：它 32 kHz 下用 810/878/940/1012，
//    正是 1116/1188/1277/1356 × 32/44.1。）
//
//  ===========================================================================
//  ★ 资源估算（⚠️ 未综合，是"按模板推算"的数字，不是实测）
//  ===========================================================================
//  官方 UG300：一块 BSRAM = 18 Kbit ⇒ 16 bit 数据一块只能放 1024 个样本。
//      延迟线 32768 × 16 bit ⇒ 29 块
//      梳状 4 × 4096 × 16 bit ⇒ 4 × 4 = 16 块
//      全通 2 × 2048 × 16 bit ⇒ 2 × 2 = 4 块
//      合唱      2048 × 16 bit ⇒ 2 块
//      合计约 **51 块 / 340 块 = 15%**
//  乘法器：约 8 个 16×8（DSP 或 LUT 实现均可），相对 298 个 18×18 富余。
//  逻辑：寄存器 ~120 FF + 组合逻辑若干 LUT，量级可忽略。
//  ⚠️ 这 51 块是**推算值**：本任务不跑 gw_sh（构建由 Lead 串行负责），
//     实际数字必须由综合报告确认。
// =============================================================================
`default_nettype none

module audio_fx #(
    // 契约参数：0=旁路 1=延迟 2=合唱 3=混响。最高档位序号 = 3。
    // 本模块内部不需要它做译码（fx_sel 已经是 2 bit），保留以符合契约、
    // 并为将来扩展更多效果档预留。
    parameter integer N_FX = 3
)(
    input  wire        clk,
    input  wire        rst_n,
    input  wire        sample_tick,      // 97 656.25 Hz

    input  wire [1:0]  fx_sel,           // 00=旁路 01=延迟 10=合唱 11=混响
    input  wire [6:0]  param,            // 0..127 深度/反馈量

    input  wire signed [15:0] fx_in,
    output reg  signed [15:0] fx_out
);

    localparam [1:0] FX_BYPASS = 2'b00,
                     FX_DELAY  = 2'b01,
                     FX_CHORUS = 2'b10,
                     FX_REVERB = 2'b11;

    // =========================================================================
    //  清缓冲发生器（见文件头：不清就可能 railed）
    // =========================================================================
    localparam integer CLR_MAX = 32768;    // 必须 ≥ 最长延迟线深度（延迟线 32768）
    localparam [15:0]  CLR_MAX_C = CLR_MAX;   // sized 承接，避免对 integer 参数位选
    reg [15:0] clr_cnt;
    reg        clr_en;
    wire [14:0] clr_addr = clr_cnt[14:0];

    always @(posedge clk) begin
        if (!rst_n) begin
            clr_cnt <= 16'd0;
            clr_en  <= 1'b1;               // 复位一释放立刻开始清扫
        end else if (clr_cnt < CLR_MAX_C) begin
            clr_cnt <= clr_cnt + 16'd1;
            clr_en  <= 1'b1;
        end else begin
            clr_en  <= 1'b0;
        end
    end

    // =========================================================================
    //  效果 1：延迟 / 回声
    // =========================================================================
    wire signed [15:0] echo_y;
    fx_echo #(.AW(15), .DEPTH(32768), .LEN_MIN(9766)) u_echo (
        .clk(clk), .rst_n(rst_n), .sample_tick(sample_tick),
        .clr_en(clr_en), .clr_addr(clr_addr),
        .param(param), .x(fx_in), .y(echo_y)
    );

    // =========================================================================
    //  效果 2：合唱
    // =========================================================================
    wire signed [15:0] chor_y;
    fx_chorus #(.AW(11), .DEPTH(2048), .BASE(1024), .LFO_INC(137)) u_chorus (
        .clk(clk), .rst_n(rst_n), .sample_tick(sample_tick),
        .clr_en(clr_en), .clr_addr(clr_addr),
        .param(param), .x(fx_in), .y(chor_y)
    );

    // =========================================================================
    //  效果 3：Schroeder/Freeverb 混响 —— 4 并联梳状 + 2 串联全通
    // =========================================================================
    // 输入固定衰减 1/64 = 0.015625（≈ Freeverb 的 fixedgain 0.015），
    // 理由与最坏情况核算见文件头"输入电平必须算过"一节：0.015625 × 18.3 = 0.286 < 1。
    wire signed [15:0] rev_in = fx_in >>> 6;

    // 梳状反馈：0.699 ~ 0.945（Q8 179~242），覆盖 Freeverb 可用区间的下半段。
    //   · 0.699 ⇒ T60 ≈ 0.59 s（小房间）
    //   · 0.945 ⇒ T60 ≈ 3.7 s（大教堂）
    //   计算依据：T60 = -3·L / log10(g)，L 取最长梳状 3003 采样点 = 30.7 ms。
    //   ⚠️ 上限刻意停在 0.945 而不是 Freeverb 的 0.98：留 5.5% 余量，见文件头
    //     关于"算术右移取整偏差会不会把 g 推过 1"的核算。
    wire [7:0] comb_fb = 8'd179 + {1'b0, param[6:1]};

    wire signed [15:0] c0, c1, c2, c3;
    fx_comb #(.AW(12), .DEPTH(4096), .DLY(2471)) u_c0 (
        .clk(clk), .rst_n(rst_n), .sample_tick(sample_tick),
        .clr_en(clr_en), .clr_addr(clr_addr),
        .x(rev_in), .fb_q8(comb_fb), .y(c0));
    fx_comb #(.AW(12), .DEPTH(4096), .DLY(2631)) u_c1 (
        .clk(clk), .rst_n(rst_n), .sample_tick(sample_tick),
        .clr_en(clr_en), .clr_addr(clr_addr),
        .x(rev_in), .fb_q8(comb_fb), .y(c1));
    fx_comb #(.AW(12), .DEPTH(4096), .DLY(2828)) u_c2 (
        .clk(clk), .rst_n(rst_n), .sample_tick(sample_tick),
        .clr_en(clr_en), .clr_addr(clr_addr),
        .x(rev_in), .fb_q8(comb_fb), .y(c2));
    fx_comb #(.AW(12), .DEPTH(4096), .DLY(3003)) u_c3 (
        .clk(clk), .rst_n(rst_n), .sample_tick(sample_tick),
        .clr_en(clr_en), .clr_addr(clr_addr),
        .x(rev_in), .fb_q8(comb_fb), .y(c3));

    // 4 路并联求和（4×16 bit → 18 bit 承接，防中间溢出）
    wire signed [17:0] comb_sum = c0 + c1 + c2 + c3;
    wire signed [15:0] ap_in    = comb_sum >>> 2;      // 取平均，保持电平可控

    // 两级串联全通扩散器（g = 0.5，Freeverb 同）
    wire signed [15:0] ap1_y, ap2_y;
    fx_allpass #(.AW(11), .DEPTH(2048), .DLY(1231)) u_ap1 (
        .clk(clk), .rst_n(rst_n), .sample_tick(sample_tick),
        .clr_en(clr_en), .clr_addr(clr_addr),
        .x(ap_in), .fb_q8(8'd128), .y(ap1_y));
    fx_allpass #(.AW(11), .DEPTH(2048), .DLY(977)) u_ap2 (
        .clk(clk), .rst_n(rst_n), .sample_tick(sample_tick),
        .clr_en(clr_en), .clr_addr(clr_addr),
        .x(ap1_y), .fb_q8(8'd128), .y(ap2_y));

    // 湿度：param << 1（0 ~ 0.99）。param=0 ⇒ 湿声 0 ⇒ 等于干声直通。
    wire [7:0]         wet_q8 = {param, 1'b0};
    wire signed [24:0] wet_f  = ap2_y * $signed({1'b0, wet_q8});
    wire signed [16:0] wet_s  = wet_f >>> 8;
    wire signed [17:0] rev_f  = {fx_in[15], fx_in} + {{1'b0, wet_s[16]}, wet_s};
    wire signed [15:0] rev_y  = sat16(rev_f);

    function signed [15:0] sat16;
        input signed [17:0] v;
        begin
            if      (v > 18'sd32767)  sat16 = 16'sd32767;
            else if (v < -18'sd32768) sat16 = -16'sd32768;
            else                      sat16 = v[15:0];
        end
    endfunction

    // =========================================================================
    //  输出选择
    // =========================================================================
    always @(*) begin
        if (fx_sel == FX_BYPASS) begin
            // ★ 旁路必须【逐 bit 直通】，不经过任何寄存器/增益：
            //   验收判据之一就是"fx_sel=00 时 fx_out == fx_in"。
            fx_out = fx_in;
        end else if (clr_en) begin
            // 清缓冲期间静音：此时延迟线内容无意义，不能让它漏到输出
            fx_out = 16'sd0;
        end else begin
            case (fx_sel)
                FX_DELAY:  fx_out = echo_y;
                FX_CHORUS: fx_out = chor_y;
                default:   fx_out = rev_y;      // FX_REVERB
            endcase
        end
    end

endmodule

`default_nettype wire
